## prj.conf
```kconfig
CONFIG_USB_DEVICE_STACK_NEXT=y

CONFIG_STDOUT_CONSOLE=y
CONFIG_SERIAL=y
CONFIG_UART_LINE_CTRL=y
CONFIG_USBD_CDC_ACM_CLASS=y
CONFIG_CDC_ACM_SERIAL_INITIALIZE_AT_BOOT=n

CONFIG_SAMPLE_USBD_PID=0x0001
CONFIG_SAMPLE_USBD_PRODUCT="USBD CDC ACM sample"

CONFIG_LOG=y
# CONFIG_LOG_MODE_DEFERRED=n
CONFIG_LOG_MODE_IMMEDIATE=y
CONFIG_LOG_RUNTIME_FILTERING=y
# CONFIG_LOG_BUFFER_SIZE=2048
CONFIG_LOG_PRINTK=y
CONFIG_LOG_PROCESS_TRIGGER_THRESHOLD=0
CONFIG_COVERAGE=n
CONFIG_LOG_TAG_MAX_LEN=8

CONFIG_HEAP_MEM_POOL_SIZE=256

CONFIG_GPIO=y
CONFIG_SPI=y

# CONFIG_UART_ASYNC_API=y
# CONFIG_UART_0_ASYNC=y
# CONFIG_LOG_BACKEND_UART_ASYNC=y
```

## src/main.c
```c
#include <stdio.h>

int main(void)
{
	printf("Hello World! %s\n", CONFIG_BOARD_TARGET);

	return 0;
}
```

## src/beat_detector.c
```c
#include "beat_detector.h"
#include <string.h>

void beat_detector_init(BeatDetector* detector)
{
    memset(detector->history, 0, sizeof(detector->history));
    detector->history_ptr = detector->history;
    detector->energy = 0.0f;
    detector->variance = 0.0f;
    detector->average_energy = 0.0f;
    detector->threshold = BASE_THRESHOLD; // Threshold multiplier for beat detection
}

void beat_detector_update(BeatDetector* detector, const float* samples, size_t num_samples)
{
    // Calculate energy of the current frame
    float energy = 0.0f;
    for (size_t i = 0; i < num_samples; ++i) {
        energy += samples[i] * samples[i];
    }
    energy /= num_samples;

    // Update history with the new energy value and check circular buffer
    *detector->history_ptr = energy;
    detector->history_ptr++;
    if (detector->history_ptr >= detector->history + BEAT_DETECTOR_HISTORY_SIZE) {
        detector->history_ptr = detector->history;
    }

    // Update average energy and variance
    float sum_energy = 0.0f;
    for (size_t i = 0; i < BEAT_DETECTOR_HISTORY_SIZE; ++i) {
        sum_energy += detector->history[i];
    }
    detector->average_energy = sum_energy / BEAT_DETECTOR_HISTORY_SIZE;

    float variance_sum = 0.0f;
    for (size_t i = 0; i < BEAT_DETECTOR_HISTORY_SIZE; ++i) {
        variance_sum += (detector->history[i] - detector->average_energy) * (detector->history[i] - detector->average_energy);
    }
    detector->variance = variance_sum / BEAT_DETECTOR_HISTORY_SIZE;

    // Update current energy
    detector->energy = energy;

    /* dynamically adjust the multiplier */
    /* threshold = base + scale * normalized‑variance; clamp to sane range */
    float norm_var = detector->variance / (detector->average_energy + 1e-6f);
    detector->threshold = BASE_THRESHOLD + VARIANCE_SCALE * norm_var;
    if (detector->threshold < 1.0f) detector->threshold = 1.0f;
    if (detector->threshold > 3.0f) detector->threshold = 3.0f;
}

int beat_detector_is_beat(const BeatDetector* detector)
{
    // A beat is detected if the current energy is significantly higher than the average energy
    return (detector->energy > detector->threshold * detector->average_energy);
}
```

## src/beat_detector.h
```c
#ifndef _BEAT_DETECTOR_H_
#define _BEAT_DETECTOR_H_

#define BASE_THRESHOLD   1.0f   /* nominal multiplier */
#define VARIANCE_SCALE   2.0f   /* how strongly variance affects it */
#define BEAT_DETECTOR_HISTORY_SIZE 43 /* 43 is the number of frames in 1 second at 1024 samples/frame and 44100 samples/second */

typedef struct {
    float history[BEAT_DETECTOR_HISTORY_SIZE];
    float *history_ptr;
    float energy;
    float variance;
    float average_energy;
    float threshold;
} BeatDetector;

void beat_detector_init(BeatDetector* detector);
void beat_detector_update(BeatDetector* detector, const float* samples, size_t num_samples);
int beat_detector_is_beat(const BeatDetector* detector);

#endif // _BEAT_DETECTOR_H_
```
